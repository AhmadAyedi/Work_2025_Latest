LIN_description_file;
LIN_protocol_version = "2.0";
LIN_language_version = "2.0";
LIN_speed = 19.2 kbps;

Nodes {
  Master: STM_Master, 1 ms, 0 ms ;
  Slaves: Arduino_Slave ;
}

Signals {
  Message_Signal: 40, {0, 0, 0, 0, 0}, STM_Master, Arduino_Slave ;
}

Frames {
  Message_Frame: 1, STM_Master, 5 {
    Message_Signal, 0 ;
  }
}

Node_attributes {
  Arduino_Slave{
    LIN_protocol = "2.0" ;
    configured_NAD = 0x1 ;
    product_id = 0x0, 0x0, 255 ;
    P2_min = 0 ms ;
    ST_min = 0 ms ;
    configurable_frames {
      Message_Frame = 0x0 ;
    }
  }
}

Schedule_tables {
 ScheduleTable {
    Message_Frame delay 10 ms ;
  }
}
