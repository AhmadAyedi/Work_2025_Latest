VERSION ""

NS_ :

BS_:

BU_: RaspPi1 RaspPi2

BO_ 256 TemperatureMessage: 8 RaspPi1
 SG_ temperature : 0|8@1+ (1,0) [0|255] "°C" RaspPi2
