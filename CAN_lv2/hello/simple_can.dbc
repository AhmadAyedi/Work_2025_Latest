VERSION "1.0"

NS_ :

BS_:

BU_: RASP1 RASP2

BO_ 256 HelloMessage: 8 RASP1
      SG_ HelloString : 0|64@1+ (1,0) [0|0] "" RASP2

CM_ BO_ 256 "Message carrying a hello string from RASP1 to RASP2";
CM_ SG_ 256 HelloString "8-byte signal for string data";
