VERSION ""

NS_ :

BS_:

BU_: receivePi senderPi

BO_ 256 TemperatureMsg: 2 senderPi
 SG_ Temperature : 0|16@1+ (0.1,0) [0|1000] "degC"  receivePi

CM_ BU_ receivePi "Raspberry Pi node that receives the CAN message.";
CM_ BU_ senderPi "Add “Raspberry Pi node that sends the CAN message.”
Leave other fields (e.g., attributes) as default.";
CM_ BO_ 256 "Message containing temperature data.";
BA_DEF_  "BusType" STRING ;
BA_DEF_DEF_  "BusType" "CAN";
