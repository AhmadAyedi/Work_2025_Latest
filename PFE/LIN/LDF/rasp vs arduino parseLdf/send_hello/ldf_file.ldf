LIN_description_file;
LIN_protocol_version = "2.0";
LIN_language_version = "2.0";
LIN_speed = 19.2 kbps;

Nodes {
  Master: Master, 1 ms, 0 ms ;
  Slaves: Slave ;
}

Signals {
  Request_Signal: 8, {0}, Master, Slave ;
  Response_Signal: 8, 0, Slave, Master ;
}

Frames {
  Request_Frame: 10, Master, 8 {
    Request_Signal, 0 ;
  }
  Response_Frame: 20, Slave, 8 {
    Response_Signal, 0 ;
  }
}

Node_attributes {
  Slave{
    LIN_protocol = "2.0" ;
    configured_NAD = 0xFF ;
    product_id = 0x2, 0x0, 255 ;
    P2_min = 0 ms ;
    ST_min = 0 ms ;
    configurable_frames {
      Request_Frame = 0x0 ;
      Response_Frame = 0x0 ;
    }
  }
}

Schedule_tables {
 Schedule {
    Request_Frame delay 10 ms ;
    Response_Frame delay 10 ms ;
  }
}
