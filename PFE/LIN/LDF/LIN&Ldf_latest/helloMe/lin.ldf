LIN_description_file;
LIN_protocol_version = "2.0";
LIN_language_version = "2.0";
LIN_speed = 19.2 kbps;

Nodes {
  Master: master, 1 ms, 0 ms ;
  Slaves: slave ;
}

Signals {
  MasterReqFrame_NewSignal: 8, 0, master, slave ;
  SlaveRespFrame_NewSignal: 8, 0, slave, master ;
}

Frames {
  MasterReqFrame: 1, master, 8 {
    MasterReqFrame_NewSignal, 0 ;
  }
  SlaveRespFrame: 2, slave, 8 {
    SlaveRespFrame_NewSignal, 0 ;
  }
}

Node_attributes {
  slave{
    LIN_protocol = "2.0" ;
    configured_NAD = 0xFF ;
    product_id = 0x0, 0x0, 255 ;
    P2_min = 0 ms ;
    ST_min = 0 ms ;
    configurable_frames {
      MasterReqFrame = 0x0 ;
      SlaveRespFrame = 0x0 ;
    }
  }
}

Schedule_tables {
 ScheduleTable {
    MasterReqFrame delay 10 ms ;
    SlaveRespFrame delay 10 ms ;
  }
}
