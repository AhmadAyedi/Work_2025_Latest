LIN_description_file;
LIN_protocol_version = "2.0";
LIN_language_version = "2.0";
LIN_speed = 19.2 kbps;

Nodes {
  Master: RaspberryPiMaster, 1 ms, 0 ms ;
  Slaves: RaspberryPiSlave ;
}

Signals {
  ButtonSignal: 8, 0, RaspberryPiMaster, RaspberryPiSlave ;
  LEDStatusSignal: 8, 0, RaspberryPiSlave, RaspberryPiMaster ;
}

Frames {
  Request_Frame: 10, RaspberryPiMaster, 8 {
    ButtonSignal, 0 ;
  }
  Response_Frame: 20, RaspberryPiSlave, 8 {
    LEDStatusSignal, 0 ;
  }
}

Node_attributes {
  RaspberryPiSlave{
    LIN_protocol = "2.0" ;
    configured_NAD = 0xFF ;
    product_id = 0x0, 0x0, 255 ;
    P2_min = 0 ms ;
    ST_min = 0 ms ;
    configurable_frames {
      Request_Frame = 0x0 ;
      Response_Frame = 0x0 ;
    }
  }
}

Schedule_tables {
 ScheduleTable {
    Request_Frame delay 10 ms ;
    Response_Frame delay 10 ms ;
  }
}
