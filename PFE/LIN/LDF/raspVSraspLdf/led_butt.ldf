LIN_description_file;
LIN_protocol_version = "2.0";
LIN_language_version = "2.0";
LIN_speed = 19.2 kbps;

Nodes {
  Master: raspMasterLed, 1 ms, 0 ms ;
  Slaves: SlaveButt ;
}

Signals {
  sendReq_NewSignal: 8, 0, raspMasterLed, SlaveButt ;
  responseButt_NewSignal: 8, 0, SlaveButt, raspMasterLed ;
}

Frames {
  sendReq: 1, raspMasterLed, 8 {
    sendReq_NewSignal, 0 ;
  }
  responseButt: 2, SlaveButt, 8 {
    responseButt_NewSignal, 0 ;
  }
}

Node_attributes {
  SlaveButt{
    LIN_protocol = "2.0" ;
    configured_NAD = 0xFF ;
    product_id = 0x0, 0x0, 255 ;
    P2_min = 0 ms ;
    ST_min = 0 ms ;
    configurable_frames {
      sendReq = 0x0 ;
      responseButt = 0x0 ;
    }
  }
}

Schedule_tables {
 schedule1 {
    sendReq delay 10 ms ;
    responseButt delay 10 ms ;
  }
}
