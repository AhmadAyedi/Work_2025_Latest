LIN_description_file;
LIN_protocol_version = "2.0";
LIN_language_version = "2.0";
LIN_speed = 19.2 kbps;

Nodes {
  Master: LIN_Commander, 1 ms, 0 ms ;
  Slaves: LIN_Responder, arduino1 ;
}

Signals {
  req1_NewSignal: 8, 0, LIN_Commander, arduino1 ;
  response_NewSignal: 8, 0, arduino1, LIN_Commander ;
}

Frames {
  req1: 1, LIN_Commander, 8 {
    req1_NewSignal, 0 ;
  }
  response: 2, arduino1, 8 {
    response_NewSignal, 0 ;
  }
}

Node_attributes {
  LIN_Responder{
    LIN_protocol = "2.0" ;
    configured_NAD = 0xFF ;
    product_id = 0x0, 0x0, 255 ;
    P2_min = 0 ms ;
    ST_min = 0 ms ;
  }
  arduino1{
    LIN_protocol = "2.0" ;
    configured_NAD = 0xFF ;
    product_id = 0x0, 0x0, 255 ;
    P2_min = 0 ms ;
    ST_min = 0 ms ;
    configurable_frames {
      req1 = 0x0 ;
      response = 0x0 ;
    }
  }
}

Schedule_tables {
 New_ScheduleTable {
    req1 delay 10 ms ;
    response delay 10 ms ;
  }
}
