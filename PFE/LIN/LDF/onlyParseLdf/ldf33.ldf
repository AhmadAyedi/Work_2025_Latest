LIN_description_file;
LIN_protocol_version = "2.0";
LIN_language_version = "2.0";
LIN_speed = 19.2 kbps;

Nodes {
  Master: LIN_Commander, 1 ms, 0 ms ;
  Slaves: LIN_Responder, salve1 ;
}

Signals {
  frame11: 8, 0, LIN_Commander, salve1 ;
}

Frames {
  frame1: 12, LIN_Commander, 8 {
    frame11, 0 ;
  }
}

Node_attributes {
  LIN_Responder{
    LIN_protocol = "2.0" ;
    configured_NAD = 0xFF ;
    product_id = 0x0, 0x0, 255 ;
    P2_min = 0 ms ;
    ST_min = 0 ms ;
  }
  salve1{
    LIN_protocol = "2.0" ;
    configured_NAD = 0xFF ;
    product_id = 0x0, 0x0, 255 ;
    P2_min = 0 ms ;
    ST_min = 0 ms ;
    configurable_frames {
      frame1 = 0x0 ;
    }
  }
}

Schedule_tables {
 schedule1 {
    frame1 delay 10 ms ;
  }
}
